/********************************************************************************

						步进电机实验

					正转两圈，反转两圈
				

*********************************************************************************/



#include <reg52.h>

unsigned char timer1; 

unsigned char foward[] = {0x20,0x30,0x10,0x18,0x08,0x0c,0x04,0x24};			   //0010 0000	 0011 0000
unsigned char reverse[] = {0x24,0x04,0x0c,0x08,0x18,0x10,0x30,0x20};

sbit PWM=P1^2;
sbit V = P1^3;
sbit W = P1^4;

void delay()
{
	int i,j;
	for(i = 0; i < 2; i++)
		for(j = 0; j < 100; j++);
}


void main()
{
	int i = 0;
	int j = 0;

	while(1)
	{
		for(i = 0; i < 16*64; i++)		  //传速比为64	 16为转两圈
		{
			for(j = 0; j < 8; j++)		 //步距角为45/8，改循环内部传动轮一共转了45度
			{
				P1 = foward[j];
				delay();
			}
		}
		
		for(i = 0; i < 16*64; i++)
		{
			for(j = 0; j < 8; j++)
			{
				P1 = reverse[j];
				delay();
			}
		}			
	}
	

}

/*************************************
 [ t1 (0.5ms)中断] 中断中做 PWM 输出
  ------------1000/(0.02ms*250)=200Hz
*************************************/
void T1zd(void) interrupt 3    //3 为定时器1的中断号  1 定时器0的中断号 0 外部中断1 2 外部中断2  4 串口中断
{
	TH1 = 0xfe; //11.0592
	TL1 = 0x33;
	 timer1++;
    
}


