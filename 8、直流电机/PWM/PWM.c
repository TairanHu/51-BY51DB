/**************************************************
				
				直流电机实验

		使用定时器中断0，来实现直流电机PWM

***************************************************/

#include <reg52.h>

sbit PWM = P1^2;
unsigned char Count;

/*************************************************

			定时器0初始化函数

**************************************************/
void Timer0_Init()
{
	TMOD = 0x01;			   // 设置定时器0的工作方式
	TH0 = (65536 - 5000)/256;  // 对寄存器装入初值，高八位
	TL0 = (65536 - 5000)%256;  // 低八位
	ET0 = 1;				   // 开启定时器0中断
	TR0 = 1;				   // 启动定时器0
	EA = 1;					   // 开总中断
}



/**************************************************

			   	主函数

***************************************************/

void main()
{
	Timer0_Init();	   // 初始化定时器
	while(1)		   // 等待中断的发生
	{
		if(Count <= 30)
		{
			PWM = 0;
		}
		else
		{
			PWM = 1;
		}
		if(Count >= 100)
		{

			Count = 0;
		}
	
	}
}


/**************************************************

			   定时器0中断服务程序

***************************************************/

void Timer0() interrupt 1
{
	TH0 = (65536 - 100)/256;  // 对寄存器装入初值，高八位
	TL0 = (65536 - 100)%256;  // 低八位

	Count++;

}





