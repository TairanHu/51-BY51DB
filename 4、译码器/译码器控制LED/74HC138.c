/**********************************************************

			采用74HC138控制流水灯

			用排线将U10JP与DJP相连

***********************************************************/

#include <reg52.h>

sbit HC138A = P2^2;			//定义译码器输入端A  在 P2.2 管脚上
sbit HC138B = P2^3;			//定义译码器输入端B  在 P2.3 管脚上
sbit HC138C = P2^4;			//定义译码器输入端C  在 P2.4 管脚上			



/***********************************************************

		  				延时函数

************************************************************/
void delay()
{
	int i, j;
	for(i = 0; i < 100; i++)
	{
		for(j = 0;j < 110; j++)	;
	}
} 



/**********************************************************

						主函数

**********************************************************/

void main()
{
	while(1)
	{

		//************点亮第一个LED************//
		HC138C = 0; HC138B = 0; HC138A = 0;
		delay();
		//************点亮第二个LED************//
		HC138C = 0; HC138B = 0; HC138A = 1;
		delay();
		//************点亮第三个LED************//
		HC138C = 0; HC138B = 1; HC138A = 0;
		delay();
		//************点亮第四个LED************//
		HC138C = 0; HC138B = 1; HC138A = 1;
		delay();
		//************点亮第五个LED************//
		HC138C = 1; HC138B = 0; HC138A = 0;
		delay();
		//************点亮第六个LED************//
		HC138C = 1; HC138B = 0; HC138A = 1;
		delay();
		//************点亮第七个LED************//
		HC138C = 1; HC138B = 1; HC138A = 0;
		delay();
		//************点亮第八个LED************//
		HC138C = 1; HC138B = 1; HC138A = 1;
		delay();

				
	}
}


