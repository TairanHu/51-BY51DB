/**************************************************
					舵机操作实验
			使用定时器中断0，来实现舵机的打脚，
	分别打脚45度，90度，135度和180度，循环一次一共是2秒

***************************************************/

#include <reg52.h>

sbit PWM = P3^7;
unsigned char Count;
int Count1 = 0;

/*************************************************

			定时器0初始化函数

**************************************************/
void Timer0_Init()
{
	TMOD = 0x01;			   // 设置定时器0的工作方式
	TH0 = (65536 - 500)/256;  // 对寄存器装入初值，高八位
	TL0 = (65536 - 500)%256;  // 低八位
	ET0 = 1;				   // 开启定时器0中断
	TR0 = 1;				   // 启动定时器0
	EA = 1;					   // 开总中断
}



/**************************************************

			   	主函数

***************************************************/

void main()
{

	int n = 1;
	Timer0_Init();	   // 初始化定时器
	while(1)		   // 等待中断的发生
	{				
		if(Count >= 40)
		{

			Count = 0;
		}
		else
		{
			if(Count <= 1*n)
			{
				PWM = 1;
			}
			else
			{
				PWM = 0;
			}
		}
		

		if(Count1 > 1000)
		{
			n++;  
			Count1 = 0;
			if(n > 5)
			{
				n = 1;
			}
			
		}
	
	}
}


/**************************************************

			   定时器0中断服务程序

***************************************************/

void Timer0() interrupt 1
{
	TH0 = (65536 - 500)/256;  // 对寄存器装入初值，高八位
	TL0 = (65536 - 500)%256;  // 低八位

	Count++;
	Count1++;

}





