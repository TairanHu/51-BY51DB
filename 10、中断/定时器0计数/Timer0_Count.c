/**************************************************

		使用定时器中断0计数，数码管显示

***************************************************/

#include <reg52.h>

#define uchar unsigned char

sbit HC138A = P2^2;			//定义译码器输入端A  在 P2.2 管脚上
sbit HC138B = P2^3;			//定义译码器输入端B  在 P2.3 管脚上
sbit HC138C = P2^4;			//定义译码器输入端C  在 P2.4 管脚上			

uchar code table[] = {0x3F, 0x06, 0x5B, 0x4F, 0x66, 0x6D, 0x7D, 0x07, 0x7F, 0x6F, 0x77, 0x7C, 0x39, 0x5E, 0x79, 0x71};

uchar Count;

int Num_High = 0 , Num_Low = 0;	 //定义数字的高四位和低四位

void delay_nms(int n)
{
	int i, j;
	for(i = 0; i < n; i++)
	{
		for(j = 0; j < 110; j++) ;
	}
}


/*************************************************

			定时器0初始化函数

**************************************************/
void Timer0_Init()
{
	TMOD = 0x01;			   // 设置定时器0的工作方式
	TH0 = (65536 - 50000)/256;  // 对寄存器装入初值，高八位
	TL0 = (65536 - 50000)%256;  // 低八位
	ET0 = 1;				   // 开启定时器0中断
	TR0 = 1;				   // 启动定时器0
	EA = 1;					   // 开总中断
}



/**************************************************

			   	主函数

***************************************************/

void main()
{
//	int Num_High , Num_Low;	 //定义数字的高四位和低四位

	uchar LED_Out[8] = {0};

	Timer0_Init();	   // 初始化定时器

	while(1)		   // 等待中断的发生
	{
		if(Num_Low >= 10000)
		{
			Num_High++;
			Num_Low %= 1000;
		}

		LED_Out[0] = Num_Low%10;			//取出数字个位
		LED_Out[1] = Num_Low/10%10;         //取出数字十位
		LED_Out[2] = Num_Low/100%10;        //取出数字百位
		LED_Out[3] = Num_Low/1000%10;       //取出数字千位
                                            
		LED_Out[4] = Num_High%10;           //取出数字万位
		LED_Out[5] = Num_High/10%10;        //取出数字十万位
		LED_Out[6] = Num_High/100%10;       //取出数字百万位
		LED_Out[7] = Num_High/1000%10;      //取出数字千万位


		HC138C = 0; HC138B = 0; HC138A = 0; 	//选中数码管第一位
		P1 = table[LED_Out[7]];                 //显示数字
		delay_nms(1);                           //延时
		P1 = 0x00;								//消影
		                                        
		HC138C = 0; HC138B = 0; HC138A = 1;     //选中数码管第二位
		P1 = table[LED_Out[6]];                 //显示数字
		delay_nms(1);                           //延时
		P1 = 0x00;								//消影
		                                        
		HC138C = 0; HC138B = 1; HC138A = 0;     //选中数码管第三位
		P1 = table[LED_Out[5]];                 //显示数字
		delay_nms(1);                           //延时
		P1 = 0x00;								//消影
		                                        
		HC138C = 0; HC138B = 1; HC138A = 1;     //选中数码管第四位
		P1 = table[LED_Out[4]];                 //显示数字
		delay_nms(1);                           //延时
		P1 = 0x00;								//消影
		                                        
		HC138C = 1; HC138B = 0; HC138A = 0;     //选中数码管第五位
		P1 = table[LED_Out[3]];                 //显示数字
		delay_nms(1);                           //延时
		                                        
		HC138C = 1; HC138B = 0; HC138A = 1;     //选中数码管第六位
		P1 = table[LED_Out[2]];                 //显示数字
		delay_nms(1);                           //延时
		P1 = 0x00;								//消影
		                                        
		HC138C = 1; HC138B = 1; HC138A = 0;     //选中数码管第七位
		P1 = table[LED_Out[1]];                 //显示数字
		delay_nms(1);                           //延时
		P1 = 0x00;								//消影
		                                        
		HC138C = 1; HC138B = 1; HC138A = 1;     //选中数码管第八位
		P1 = table[LED_Out[0]];                 //显示数字
		delay_nms(1);                           //延时
		P1 = 0x00;								//消影
	
	}
}


/**************************************************

			   定时器0中断服务程序

***************************************************/

void Timer0() interrupt 1
{
	TH0 = (65536 - 10000)/256;  // 对寄存器装入初值，高八位
	TL0 = (65536 - 10000)%256;  // 低八位

	Num_Low++;

}





