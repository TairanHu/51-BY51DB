/********************************************************

					点阵实验
				
				LED点阵显示数字						
	连接方法：P1口排针与8位数码管左边排针U11_JP1相连接
			  P0口排针与点阵右边排针LAH_R用排线相连接

********************************************************/


#include<reg52.h>

unsigned char code tab[]={0xfe,0xfd,0xfb,0xf7,0xef,0xdf,0xbf,0x7f};

/************************* 数字 0-9 取模 *************************/
unsigned char code digittab[18][8]={

{0x00,0x00,0x3e,0x41,0x41,0x41,0x3e,0x00}, //0	  0011 1110  0100 0001

{0x00,0x00,0x00,0x00,0x21,0x7f,0x01,0x00}, //1
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{0x00,0x00,0x32,0x49,0x49,0x49,0x3e,0x00}, //9

};

unsigned int timecount1 , timecount2;

unsigned char cntx , cnty ;


/**************************************************

			   	主函数

***************************************************/
void main(void)
{
	cnty = 0;
  
	while(1)
	{
//		P0 = 0x00;	 		
		P1 = tab[cntx];  // 列线
		P0 = digittab[cnty][cntx];   // 行线

	 //用于控制动态扫描的速度
	  if(++timecount1 >= 50)
	  {
		timecount1 = 0;
		if(++cntx >= 8) 
		{
			cntx=0;
		}
		P0 = 0x00;			//消影
	  }

	 
	 //用于控制动字符间的切换速度
	  if(++timecount2 >= 20000)
	  {
		timecount2 = 0;
		if(++cnty > 9)
		{
			cnty = 0;
		}
	  }

	}

}



